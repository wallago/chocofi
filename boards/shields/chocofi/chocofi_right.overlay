#include "./chocofi.dtsi"

&default_transform {
    col-offset = <5>;
};

&led_strip {
    chain-length = <2>;
};

&kscan0 {
    row-gpios
    = <&pro_micro 4 GPIO_ACTIVE_HIGH> // Higher Column
    , <&pro_micro 5 GPIO_ACTIVE_HIGH>
    , <&pro_micro 6 GPIO_ACTIVE_HIGH>
    , <&pro_micro 7 GPIO_ACTIVE_HIGH> // Lower Column
    ;
    col-gpios
    = <&pro_micro 15 (GPIO_ACTIVE_HIGH | GPIO_PULL_DOWN)>   // Leftest Column
    , <&pro_micro 18 (GPIO_ACTIVE_HIGH | GPIO_PULL_DOWN)>   //
    , <&pro_micro 19 (GPIO_ACTIVE_HIGH | GPIO_PULL_DOWN)>   //
    , <&pro_micro 20 (GPIO_ACTIVE_HIGH | GPIO_PULL_DOWN)>  //
    , <&pro_micro 21 (GPIO_ACTIVE_HIGH | GPIO_PULL_DOWN)>  // Rightest Column
    ;
};
