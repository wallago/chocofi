## boards/shields/v01/Kconfig.defconfig
```kconfig
if SHIELD_V01_LEFT

config ZMK_KEYBOARD_NAME
    default "chocofi"

config ZMK_SPLIT_ROLE_CENTRAL
    default y
endif

if SHIELD_V01_LEFT || SHIELD_V01_RIGHT

config ZMK_SPLIT
    default y
endif
```

## boards/shields/v01/Kconfig.shield
```kconfig
config SHIELD_V01_LEFT
    def_bool $(shields_list_contains,v01_left)

config SHIELD_V01_RIGHT
    def_bool $(shields_list_contains,v01_right)
```
